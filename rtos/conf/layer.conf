## rtos/conf/layer.conf
```bitbake
# We have a conf and classes directory, add to BBPATH
BBPATH .= ":${LAYERDIR}"

# We have recipes-* directories, add to BBFILES
BBFILES += "${LAYERDIR}/recipes-*/*/*.bb \
            ${LAYERDIR}/recipes-*/*/*.bbappend"

BBFILE_COLLECTIONS += "rtos"
BBFILE_PATTERN_rtos = "^${LAYERDIR}/"
BBFILE_PRIORITY_rtos = "7"

LAYERDEPENDS_rtos = "core"
LAYERSERIES_COMPAT_rtos = "hardknott kirkstone"
```
